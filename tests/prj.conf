## CMakeLists.txt
```
cmake_minimum_required(VERSION 3.20.0)
find_package(Zephyr REQUIRED HINTS $ENV{ZEPHYR_BASE})
project(main_testing)

target_sources(app PRIVATE src/test_main.c)
target_sources(app PRIVATE src/modules/test_hcsr04.c)
zephyr_include_directories(../src/modules)
```

## prj.conf
```kconfig
CONFIG_ZTEST=y
CONFIG_MAIN_STACK_SIZE=2048
CONFIG_SERIAL=y
CONFIG_CONSOLE=y
```

## src/main.c
```c
#include <zephyr/ztest.h>

ZTEST_SUITE(water_meter_main_suite, NULL, NULL, NULL, NULL, NULL);

ZTEST(water_meter_main_suite, test_main)
{
    zassert_true(1, "This test will always pass");
}
```

## src/test_main.c
```c
#include <zephyr/ztest.h>

ZTEST_SUITE(water_meter_main_suite, NULL, NULL, NULL, NULL, NULL);

ZTEST(water_meter_main_suite, test_main)
{
    zassert_equal(0, 0, "This test will always pass");
}
```
